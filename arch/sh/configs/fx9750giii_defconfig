## arch/sh/configs/fx9750giii_defconfig
```kconfig
CONFIG_LOCALVERSION="-fx9750giii"
# CONFIG_LOCALVERSION_AUTO is not set
CONFIG_EXPERT=y
CONFIG_BASE_SMALL=y
CONFIG_CC_OPTIMIZE_FOR_SIZE=y
CONFIG_LOG_BUF_SHIFT=12
CONFIG_PRINTK=y
CONFIG_BUG=y
CONFIG_CPU_SUBTYPE_SH7305=y
CONFIG_CPU_BIG_ENDIAN=y
CONFIG_MEMORY_START=0x08000000
CONFIG_MEMORY_SIZE=0x00080000
CONFIG_SH_FX9750GIII=y
CONFIG_CACHE_WRITEBACK=y
CONFIG_HZ_PERIODIC=y
CONFIG_HZ_100=y
CONFIG_PREEMPT_VOLUNTARY=y
CONFIG_CMDLINE_OVERWRITE=y
CONFIG_CMDLINE="ignore_loglevel loglevel=8 rdinit=/init panic=0"
CONFIG_SLUB_TINY=y
CONFIG_BINFMT_ELF=y
CONFIG_COMPAT_32BIT_TIME=y
CONFIG_BLK_DEV_INITRD=y
CONFIG_INITRAMFS_SOURCE="arch/sh/boards/mach-fx9750giii/bootinit.cpio"
CONFIG_INITRAMFS_COMPRESSION_NONE=y
CONFIG_SH_TIMER_TMU=y
# CONFIG_NO_HZ is not set
# CONFIG_NO_HZ_IDLE is not set
# CONFIG_HIGH_RES_TIMERS is not set
# CONFIG_PREEMPT is not set
# CONFIG_MODULES is not set
# CONFIG_CPU_FREQ is not set
# CONFIG_SH_STORE_QUEUES is not set
# CONFIG_HW_PERF_EVENTS is not set
# CONFIG_PERF_EVENTS is not set
# CONFIG_KEXEC is not set
# CONFIG_HEARTBEAT is not set
# CONFIG_BSD_PROCESS_ACCT is not set
# CONFIG_RELAY is not set
# CONFIG_IKCONFIG is not set
# CONFIG_KALLSYMS is not set
# CONFIG_MULTIUSER is not set
# CONFIG_UID16 is not set
# CONFIG_SYSCTL is not set
# CONFIG_POSIX_TIMERS is not set
# CONFIG_FUTEX is not set
# CONFIG_AIO is not set
# CONFIG_IO_URING is not set
# CONFIG_EPOLL is not set
# CONFIG_SIGNALFD is not set
# CONFIG_TIMERFD is not set
# CONFIG_EVENTFD is not set
# CONFIG_MEMBARRIER is not set
# CONFIG_RSEQ is not set
# CONFIG_ADVISE_SYSCALLS is not set
# CONFIG_BLOCK is not set
# CONFIG_NET is not set
# CONFIG_INPUT is not set
# CONFIG_TTY is not set
# CONFIG_VT is not set
# CONFIG_HW_RANDOM is not set
# CONFIG_I2C is not set
# CONFIG_SPI is not set
# CONFIG_PPS is not set
# CONFIG_PINCTRL is not set
# CONFIG_WATCHDOG is not set
# CONFIG_HID is not set
# CONFIG_USB_SUPPORT is not set
# CONFIG_RTC_CLASS is not set
# CONFIG_UIO is not set
# CONFIG_IOMMU_SUPPORT is not set
# CONFIG_DEVMEM is not set
# CONFIG_PROC_FS is not set
# CONFIG_SYSFS is not set
# CONFIG_TMPFS is not set
# CONFIG_SHMEM is not set
# CONFIG_NLS is not set
# CONFIG_CRYPTO is not set
# CONFIG_COREDUMP is not set
# CONFIG_BINFMT_MISC is not set
# CONFIG_PRINTK_TIME is not set
# CONFIG_PRINTK_CALLER is not set
# CONFIG_FRAME_POINTER is not set
# CONFIG_MAGIC_SYSRQ is not set
# CONFIG_DEBUG_KERNEL is not set
# CONFIG_DEBUG_VM is not set
# CONFIG_DEBUG_MEMORY_INIT is not set
# CONFIG_DEBUG_SHIRQ is not set
# CONFIG_SLUB_DEBUG is not set
# CONFIG_STACKTRACE is not set
# CONFIG_FTRACE is not set
# CONFIG_SH_STANDARD_BIOS is not set
# CONFIG_HWMON is not set
# CONFIG_FHANDLE is not set
# CONFIG_FILE_LOCKING is not set
# CONFIG_FSNOTIFY is not set
# CONFIG_DNOTIFY is not set
# CONFIG_INOTIFY_USER is not set
# CONFIG_SECURITY is not set
```
